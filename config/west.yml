## config/west.yml
```yaml
manifest:
  remotes:
    - name: urob
      url-base: https://github.com/urob/
    - name: DoctorWangWang
      url-base: https://github.com/DoctorWangWang
  projects:
    - name: zmk
      remote: urob
      revision: main
      import: app/west.yml
    - name: zmk-helpers
      remote: urob
      revision: main
    - name: zmk-pmw3610-driver
      remote: DoctorWangWang
      revision: main
      
  self:
    path: config
```
